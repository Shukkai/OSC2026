## lab1/src/kernel.its
```
/dts-v1/;

/ {
    description = "U-boot FIT Image for Orange Pi RV2";
    #address-cells = <2>;

    images {
        kernel {
            description = "Kernel Image";
            /* Note: The Makefile runs mkimage inside the build/ directory, 
               so we can reference the binary directly if it is there. 
               Using /incbin/("kernel.bin") works if kernel.bin is in build/. */
            data = /incbin/("kernel.bin");
            type = "kernel";
            arch = "riscv";
            os = "linux";
            compression = "none";
            load = <0x0 0x00200000>;
            entry = <0x0 0x00200000>;
        };

        /* ADDED: FDT Configuration */
        fdt {
            description = "Flat Device Tree";
            data = /incbin/("x1_orangepi-rv2.dtb");
            type = "flat_dt";
            arch = "riscv";
            compression = "none";
            /* Standard load address for FDT on this board */
            load = <0x0 0x31000000>;
        };
    };

    configurations {
        default = "config-1";

        config-1 {
            description = "NYCU OSC RISC-V KERNEL";
            kernel = "kernel";
            /* ADDED: Reference the fdt image defined above */
            fdt = "fdt";
        };
    };
};
```
